## arch/arm/cpu/armv7/omap3/Kconfig
```kconfig
if OMAP34XX

choice
	prompt "OMAP3 board select"

config TARGET_AM3517_EVM
	bool "AM3517 EVM"
	select SUPPORT_SPL

config TARGET_MT_VENTOUX
	bool "TeeJet Mt.Ventoux"
	select SUPPORT_SPL

config TARGET_OMAP3_SDP3430
	bool "TI OMAP3430 SDP"

config TARGET_OMAP3_BEAGLE
	bool "TI OMAP3 BeagleBoard"
	select SUPPORT_SPL

config TARGET_CM_T35
	bool "CompuLab CM-T3530 and CM-T3730 boards"
	select SUPPORT_SPL

config TARGET_CM_T3517
	bool "CompuLab CM-T3517 boards"

config TARGET_DEVKIT8000
	bool "TimLL OMAP3 Devkit8000"
	select SUPPORT_SPL

config TARGET_OMAP3_EVM
	bool "TI OMAP3 EVM"
	select SUPPORT_SPL

config TARGET_OMAP3_EVM_QUICK_MMC
	bool "TI OMAP3 EVM Quick MMC"
	select SUPPORT_SPL

config TARGET_OMAP3_EVM_QUICK_NAND
	bool "TI OMAP3 EVM Quick NAND"
	select SUPPORT_SPL

config TARGET_OMAP3_IGEP00X0
	bool "IGEP"
	select SUPPORT_SPL

config TARGET_OMAP3_OVERO
	bool "OMAP35xx Gumstix Overo"
	select SUPPORT_SPL

config TARGET_OMAP3_ZOOM1
	bool "TI Zoom1"

config TARGET_AM3517_CRANE
	bool "am3517_crane"
	select SUPPORT_SPL

config TARGET_OMAP3_PANDORA
	bool "OMAP3 Pandora"

config TARGET_ECO5PK
	bool "ECO5PK"
	select SUPPORT_SPL

config TARGET_DIG297
	bool "DIG297"

config TARGET_TRICORDER
	bool "Tricorder"
	select SUPPORT_SPL

config TARGET_MCX
	bool "MCX"
	select SUPPORT_SPL

config TARGET_OMAP3_LOGIC
	bool "OMAP3 Logic"

config TARGET_OMAP3_MVBLX
	bool "OMAP3 MVBLX"

config TARGET_NOKIA_RX51
	bool "Nokia RX51"

config TARGET_TAO3530
	bool "TAO3530"
	select SUPPORT_SPL

config TARGET_TWISTER
	bool "Twister"
	select SUPPORT_SPL

config TARGET_OMAP3_CAIRO
	bool "QUIPOS CAIRO"
	select SUPPORT_SPL

endchoice

config DM
	default y

config DM_GPIO
	default y if DM

config DM_SERIAL
	default y if DM

config SYS_SOC
	default "omap3"


endif
```

## arch/arm/cpu/armv7/omap4/Kconfig
```kconfig
if OMAP44XX

choice
	prompt "OMAP4 board select"

config TARGET_DUOVERO
	bool "OMAP4430 Gumstix Duovero"

config TARGET_OMAP4_PANDA
	bool "TI OMAP4 PandaBoard"

config TARGET_OMAP4_SDP4430
	bool "TI OMAP4 SDP4430"

endchoice

config SYS_SOC
	default "omap4"


endif
```

## arch/arm/cpu/armv7/omap5/Kconfig
```kconfig
if OMAP54XX

choice
	prompt "OMAP5 board select"

config TARGET_CM_T54
	bool "CompuLab CM-T54"

config TARGET_OMAP5_UEVM
	bool "TI OMAP5 uEVM board"

config TARGET_DRA7XX_EVM
	bool "TI DRA7XX"

config TARGET_BEAGLE_X15
	bool "BeagleBoard X15"

endchoice

config SYS_SOC
	default "omap5"


endif
```

## arch/arm/cpu/armv7/rmobile/Kconfig
```kconfig
if RMOBILE

choice
	prompt "Renesus ARM SoCs board select"

config TARGET_ARMADILLO_800EVA
	bool "armadillo 800 eva board"

config TARGET_GOSE
	bool "Gose board"

config TARGET_KOELSCH
	bool "Koelsch board"

config TARGET_LAGER
	bool "Lager board"

config TARGET_KZM9G
	bool "KZM9D board"

config TARGET_ALT
	bool "Alt board"

config TARGET_SILK
	bool "Silk board"

config TARGET_PORTER
	bool "Porter board"

endchoice

config SYS_SOC
	default "rmobile"

config RMOBILE_EXTRAM_BOOT
	bool "Enable boot from RAM"
	depends on TARGET_ALT || TARGET_KOELSCH || TARGET_LAGER || TARGET_PORTER || TARGET_SILK
	default n


endif
```

## configs/mx6adcs_eimnor_defconfig
```kconfig
CONFIG_SYS_EXTRA_OPTIONS="IMX_CONFIG=board/freescale/mx6sabresd/mx6qp.cfg,MX6QP,SYS_BOOT_EIMNOR"
CONFIG_ARM=y
CONFIG_TARGET_MX6SABRESD=y
CONFIG_SYS_MALLOC_F=y
CONFIG_SYS_MALLOC_F_LEN=0x400
CONFIG_DM=y
CONFIG_DM_THERMAL=y
CONFIG_ADCS=y
CONFIG_CMD_MTDPARTS=y
CONFIG_CMD_PART=y
```
